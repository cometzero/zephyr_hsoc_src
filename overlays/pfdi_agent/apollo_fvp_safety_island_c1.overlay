/*
 * SPDX-FileCopyrightText: <text>Copyright 2026 Arm Limited and/or its
 * affiliates <open-source-office@arm.com></text>
 *
 * SPDX-License-Identifier: Apache-2.0
 */

&mhu_tx0 {
	status = "okay";
};

&scmi_shmem {
	status = "okay";
};

&pfdi_agent {
	status = "okay";
};
