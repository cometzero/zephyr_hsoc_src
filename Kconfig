## Kconfig
```kconfig
#
# SPDX-FileCopyrightText: <text>Copyright 2026 Arm Limited and/or its
# affiliates <open-source-office@arm.com></text>
#
# SPDX-License-Identifier: Apache-2.0

rsource "boards/hsoc/apollo_fvp_safety_island_c1/Kconfig.apollo_fvp_safety_island_c1"
```

## boards/hsoc/apollo_fvp_safety_island_c1/Kconfig.apollo_fvp_safety_island_c1
```kconfig
# SPDX-FileCopyrightText: <text>Copyright 2025-2026 Arm Limited and/or its
# affiliates <open-source-office@arm.com></text>
#
# SPDX-License-Identifier: Apache-2.0

config BOARD_APOLLO_FVP_SAFETY_ISLAND
	bool "Safety Island clusters of Apollo FVP Safety Island simulation board"
	select SOC_FVP_AEMV8R_AARCH64
	select SOC_SERIES_FVP_AEMV8R

menu "Safety Island net init"

menuconfig SI_NET_INIT
	bool "Safety Island network init"
	depends on NETWORKING
	depends on NET_IPV4
	depends on NET_CONFIG_SETTINGS
	default n
	help
	  Initialize IPv4 networking for a specific interface at boot.

if SI_NET_INIT

config SI_NET_INIT_PRIORITY
	int "Network init priority"
	default 90
	range 0 99
	help
	  SYS_INIT priority for the Safety Island network init.

config SI_NET_INIT_IFACE_INDEX
	int "Interface index to configure"
	default 2
	range 1 8
	help
	  Interface index to configure (e.g. 2 for the RPMsg veth).

config SI_NET_INIT_CLEAR_IFACE_INDEX
	int "Interface index to clear"
	default 1
	range 1 8
	help
	  Interface index to clear before configuring the target interface.

endif # SI_NET_INIT

endmenu
```

## boards/hsoc/apollo_fvp_safety_island_c1/apollo_fvp_safety_island_c1_defconfig
```kconfig
# SPDX-FileCopyrightText: <text>Copyright 2025-2026 Arm Limited and/or its
# affiliates <open-source-office@arm.com></text>
#
# SPDX-License-Identifier: Apache-2.0

CONFIG_BOARD_APOLLO_FVP_SAFETY_ISLAND=y

# Image format
CONFIG_AARCH64_IMAGE_HEADER=y

# Cache management
CONFIG_CACHE_MANAGEMENT=y

CONFIG_THREAD_STACK_INFO=y

# Enable Timer and Sys clock
CONFIG_SYS_CLOCK_TICKS_PER_SEC=100
CONFIG_ARM_ARCH_TIMER=y

# Enable UART driver
CONFIG_SERIAL=y

# Enable serial port
CONFIG_UART_PL011=y

# Enable console
CONFIG_CONSOLE=y
CONFIG_UART_CONSOLE=y

# Enable simulate cpu power management
CONFIG_SOC_FVP_AEMV8R_SIMULATE_CPU_PM=y
CONFIG_PM_CPU_OPS=y
CONFIG_PM_CPU_OPS_PSCI=n
CONFIG_ARM64_SET_VMPIDR_EL2=y

CONFIG_MAX_THREAD_BYTES=3

CONFIG_SMP=y
CONFIG_MP_MAX_NUM_CPUS=4

# Enable prehook
CONFIG_SOC_PREP_HOOK=y

# Enable CRC and image integrity check
CONFIG_ENABLE_IMAGE_INTEGRITY_CHECK=y
CONFIG_CRC=y

# Shell
CONFIG_SHELL_STACK_SIZE=8192
CONFIG_SHELL_BACKEND_SERIAL_RX_RING_BUFFER_SIZE=256

# Logging
CONFIG_LOG=y
CONFIG_LOG_PRINTK=n
CONFIG_LOG_BUFFER_SIZE=4096

# Number of largest doorbells of MHUv3 device
CONFIG_MBOX_MHUV3_NUM_DBCH=32

CONFIG_COMPILER_WARNINGS_AS_ERRORS=y
```

## boards/hsoc/apollo_fvp_safety_island_c1/board.yml
```yaml
# SPDX-FileCopyrightText: <text>Copyright 2025-2026 Arm Limited and/or its
# affiliates <open-source-office@arm.com></text>
#
# SPDX-License-Identifier: Apache-2.0
---
board:
  name: apollo_fvp_safety_island_c1
  full_name: FVP Emulation Apollo FVP Safety Island cluster 1
  vendor: hsoc
  socs:
    - name: fvp_aemv8r_aarch64
```

## boards/hsoc/apollo_qvp_safety_island_c1/apollo_qvp_safety_island_c1_defconfig
```kconfig
# SPDX-FileCopyrightText: <text>Copyright 2025-2026 Arm Limited and/or its
# affiliates <open-source-office@arm.com></text>
#
# SPDX-License-Identifier: Apache-2.0

CONFIG_BOARD_APOLLO_QVP_SAFETY_ISLAND=y

# Image format
CONFIG_AARCH64_IMAGE_HEADER=y

# Cache management
CONFIG_CACHE_MANAGEMENT=y

CONFIG_THREAD_STACK_INFO=y

# Enable Timer and Sys clock
CONFIG_SYS_CLOCK_HW_CYCLES_PER_SEC=125000000
# Keep 10 ms timeout resolution without a periodic idle tick.
CONFIG_SYS_CLOCK_TICKS_PER_SEC=100
CONFIG_ARM_ARCH_TIMER=y
CONFIG_TICKLESS_KERNEL=y

# Enable UART driver
CONFIG_SERIAL=y

# Enable serial port
CONFIG_UART_PL011=y

# Enable console
CONFIG_CONSOLE=y
CONFIG_UART_CONSOLE=y

# Enable simulate cpu power management
CONFIG_SOC_FVP_AEMV8R_SIMULATE_CPU_PM=y
CONFIG_PM_CPU_OPS=y
CONFIG_PM_CPU_OPS_PSCI=n
CONFIG_ARM64_SET_VMPIDR_EL2=y

CONFIG_MAX_THREAD_BYTES=3

CONFIG_SMP=y
CONFIG_MP_MAX_NUM_CPUS=4

# Enable prehook
CONFIG_SOC_PREP_HOOK=y

# Enable CRC and image integrity check
CONFIG_ENABLE_IMAGE_INTEGRITY_CHECK=y
CONFIG_CRC=y

# Shell
CONFIG_SHELL_STACK_SIZE=8192
CONFIG_SHELL_BACKEND_SERIAL_RX_RING_BUFFER_SIZE=256

# Logging
CONFIG_LOG=y
CONFIG_LOG_PRINTK=n
CONFIG_LOG_BUFFER_SIZE=4096

# Number of largest doorbells of MHUv3 device
CONFIG_MBOX_MHUV3_NUM_DBCH=32

CONFIG_COMPILER_WARNINGS_AS_ERRORS=y

# HIPC
# Networking core
CONFIG_NETWORKING=y
CONFIG_NET_L2_ETHERNET=y
CONFIG_NET_IPV4=y
CONFIG_NET_UDP=y
CONFIG_NET_TCP=y
CONFIG_NET_PROMISCUOUS_MODE=y
CONFIG_ZVFS_POLL_MAX=9

# Network buffers and packet pools
CONFIG_NET_PKT_RX_COUNT=128
CONFIG_NET_PKT_TX_COUNT=128
CONFIG_NET_BUF_RX_COUNT=128
CONFIG_NET_BUF_TX_COUNT=128
CONFIG_NET_BUF_DATA_SIZE=2048

# Net config settings
CONFIG_NET_CONFIG_SETTINGS=y
CONFIG_NET_CONFIG_NEED_IPV4=y
CONFIG_NET_CONFIG_AUTO_INIT=n

# VLAN / traffic class
CONFIG_NET_TC_THREAD_PREEMPTIVE=y
CONFIG_NET_VLAN=y
CONFIG_NET_VLAN_COUNT=1
CONFIG_NET_TCP_PKT_ALLOC_TIMEOUT=200

# Network stack sizes / workqueues
CONFIG_NET_SOCKETS_SERVICE_STACK_SIZE=4096
CONFIG_NET_RX_STACK_SIZE=4096
CONFIG_NET_TX_STACK_SIZE=4096
CONFIG_NET_MGMT_EVENT_STACK_SIZE=2048
CONFIG_NET_TCP_WORKQ_STACK_SIZE=4096
CONFIG_NET_TC_TX_COUNT=1

# OpenAMP / RPMsg
CONFIG_OPENAMP=y
CONFIG_OPENAMP_RSC_TABLE=y
CONFIG_OPENAMP_RSC_TABLE_NUM_RPMSG_BUFF=32
CONFIG_VETH_RPMSG=y

# RPMsg VirtIO Device uses dynamic memory allocation
CONFIG_HEAP_MEM_POOL_SIZE=8192

# Mailbox
CONFIG_MBOX=y
CONFIG_MBOX_MHUV3=y

# Veth defaults
CONFIG_TEST_RANDOM_GENERATOR=y
CONFIG_VETH_MAC_ADDR="00:01:02:03:04:06"
CONFIG_VETH_NS_NAME="ethsi1"

# IP config (net config subsystem)
CONFIG_NET_IF_MAX_IPV4_COUNT=2
CONFIG_NET_CONFIG_MY_IPV4_ADDR="192.168.1.1"
CONFIG_NET_CONFIG_MY_IPV4_NETMASK="255.255.255.0"
CONFIG_NET_CONFIG_PEER_IPV4_ADDR="192.168.1.2"
CONFIG_NET_CONFIG_MY_VLAN_ID=200

# Safety island net init
CONFIG_SI_NET_INIT=y
CONFIG_SI_NET_INIT_IFACE_INDEX=2
CONFIG_SI_NET_INIT_CLEAR_IFACE_INDEX=1

# IPv6 explicitly disabled
CONFIG_NET_IPV6=n

# Shell
CONFIG_SHELL=y
CONFIG_KERNEL_SHELL=y
CONFIG_NET_SHELL=y

# ZPERF
CONFIG_NET_ZPERF=y
CONFIG_NET_STATISTICS=y

# PFDI
CONFIG_PFDI_MODULE=y
CONFIG_PFDI_MGMT=y

# Stub firmware metadata; replace when actual firmware is integrated.
CONFIG_PFDI_FW_METADATA=0x00000000

CONFIG_SOC_PER_CORE_INIT_HOOK=y
CONFIG_SCHED_CPU_MASK=y
CONFIG_PFDI_MGMT_THREAD_STACK_SIZE=4096
CONFIG_PFDI_MGMT_DEBUG=y

CONFIG_SHELL_HELP=y

CONFIG_SHELL_TAB=y
CONFIG_SHELL_TAB_AUTOCOMPLETION=y

# PFDI AGENT
CONFIG_PFDI_AGENT=y
CONFIG_PLAT_PFDI_POST_RUN_HOOK=y
CONFIG_PFDI_AGENT_LOG_LEVEL_INF=y
CONFIG_MBOX_LOG_LEVEL_ERR=y

CONFIG_LOG_MODE_DEFERRED=y
```

## boards/hsoc/apollo_qvp_safety_island_c1/board.yml
```yaml
# SPDX-FileCopyrightText: <text>Copyright 2025-2026 Arm Limited and/or its
# affiliates <open-source-office@arm.com></text>
#
# SPDX-License-Identifier: Apache-2.0
---
board:
  name: apollo_qvp_safety_island_c1
  full_name: QVP Emulation Apollo QVP Safety Island cluster 1
  vendor: hsoc
  socs:
    - name: fvp_aemv8r_aarch64
```

## boards/hsoc/apollo_si_cl1_bench/Kconfig.apollo_si_cl1_bench
```kconfig
# SPDX-License-Identifier: Apache-2.0
config BOARD_APOLLO_SI_CL1_BENCH
       select SOC_FVP_AEMV8R_AARCH64
```

## boards/hsoc/apollo_si_cl1_bench/Kconfig.defconfig
```kconfig
# SPDX-License-Identifier: Apache-2.0
if BOARD_APOLLO_SI_CL1_BENCH

config BUILD_OUTPUT_BIN
       default y

config NUM_IRQS
       default 512

endif
```

## boards/hsoc/apollo_si_cl1_bench/board.yml
```yaml
# SPDX-License-Identifier: Apache-2.0
board:
  name: apollo_si_cl1_bench
  full_name: Apollo standalone Safety Island CL1 benchmark
  vendor: hsoc
  socs:
    - name: fvp_aemv8r_aarch64
```
